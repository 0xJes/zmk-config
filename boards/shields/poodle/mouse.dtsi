#define ZMK_MOUSE_DEFAULT_SCRL_VAL 30
#define ZMK_MOUSE_DEFAULT_MOVE_VAL 800

#include <dt-bindings/zmk/mouse.h>

&mmv {
	time-to-max-speed-ms = <350>;
};

&msc {
  acceleration-exponent = <1>;
  time-to-max-speed-ms = <40>;
  delay-ms = <0>;
};
